## firmware-esp32/main/Kconfig.projbuild
```kconfig
menu "SSH Runner"

    # The board sets what differs between the boards; everything else is the same on both
    # (W5500 SPI, INT and RST, the UART to the Flipper, flash and PSRAM: checked against the
    # rev 0.1 netlist). No default that silently works on one board and not the other.
    choice FES_BOARD
        prompt "Board"
        default FES_BOARD_WAVESHARE_S3_ETH
        help
            The board this firmware runs on. It sets the status LED's type and pin.
        config FES_BOARD_WAVESHARE_S3_ETH
            bool "Waveshare ESP32-S3-ETH (prototype)"
        config FES_BOARD_SSH_RUNNER_REV0_1
            bool "SSH Runner rev 0.1"
    endchoice

    config FES_BOARD_NAME
        string
        default "Waveshare ESP32-S3-ETH" if FES_BOARD_WAVESHARE_S3_ETH
        default "SSH Runner rev 0.1" if FES_BOARD_SSH_RUNNER_REV0_1

    menu "LAN (W5500)"
        config FES_LAN_ENABLE
            bool "Enable W5500 Ethernet"
            default y

        # Defaults = Waveshare ESP32-S3-ETH, confirmed against the wiki's ETH_DHCP pin table and
        # the schematic (docs/HARDWARE.md). SSH Runner rev 0.1 uses the same pins.
        config FES_W5500_SPI_HOST
            int "SPI host (2 = SPI2)"
            default 2
        config FES_W5500_SCLK_GPIO
            int "SCLK GPIO"
            default 13
        config FES_W5500_MOSI_GPIO
            int "MOSI GPIO"
            default 11
        config FES_W5500_MISO_GPIO
            int "MISO GPIO"
            default 12
        config FES_W5500_CS_GPIO
            int "CS GPIO"
            default 14
        config FES_W5500_INT_GPIO
            int "INT GPIO, -1 to poll"
            default 10
        config FES_W5500_RST_GPIO
            int "RST GPIO, -1 if not wired"
            default 9
        config FES_W5500_SPI_MHZ
            int "SPI clock (MHz)"
            range 1 40
            default 20
        config FES_W5500_SPI_SOFT_EDGES
            bool "Weaker SCLK and MOSI drivers (softer edges)"
            default y
            help
                Sets the SPI clock and MOSI pins to drive strength 1 (about 10 mA) instead
                of the default 2 (about 20 mA). Slower edges ring less on a board without a
                series resistor on SCLK, and 20 MHz into the W5500's inputs needs nowhere
                near the default strength. Turn it off if the LAN link fails at bring-up.
    endmenu

    menu "Flipper link"
        choice FES_LINK
            prompt "Link transport"
            default FES_LINK_UART
            config FES_LINK_UART
                bool "UART1 to the Flipper (pins 13/14)"
            config FES_LINK_USB_JTAG
                bool "USB-Serial-JTAG (HIL harness; console moves off USB)"
        endchoice

        config FES_UART_TX_GPIO
            int "UART1 TX GPIO -> Flipper RX (pin 14)"
            default 17
            depends on FES_LINK_UART
        config FES_UART_RX_GPIO
            int "UART1 RX GPIO <- Flipper TX (pin 13)"
            default 18
            depends on FES_LINK_UART
        config FES_LINK_MAX_BAUD
            int "Maximum negotiated baud"
            default 921600
        config FES_DEBUG_LOG_EVT
            bool "Forward warnings to the Flipper as LOG_EVT (debug builds only)"
            default n
    endmenu

    menu "SSH"
        config FES_SSH_STACK_SIZE
            int "SSH task stack (internal RAM)"
            default 49152
        config FES_SSH_LOG_VERBOSITY
            int "libssh log verbosity (0 = none, release builds must keep 0)"
            range 0 4
            default 0
    endmenu

    menu "Status LED"
        # Type and pin come from the board, never from a separate choice:
        #   Waveshare ESP32-S3-ETH: the WS2812 RGB LED on GPIO21, shown dim red;
        #   SSH Runner rev 0.1: D201 (green) on GPIO21 through R203 to its anode, cathode to
        #   GND, so lit when the GPIO is high.
        config FES_STATUS_LED
            bool "Use the board's status LED"
            default y
            help
                Off leaves the LED dark for good. The console's `led off` does the same at
                run time and is kept in NVS.

        config FES_STATUS_LED_WS2812
            bool
            default y if FES_STATUS_LED && FES_BOARD_WAVESHARE_S3_ETH
        config FES_STATUS_LED_GPIO_PIN
            bool
            default y if FES_STATUS_LED && FES_BOARD_SSH_RUNNER_REV0_1
        config FES_STATUS_LED_GPIO
            int
            default 21
        config FES_STATUS_LED_ACTIVE_LOW
            bool
            default n
        config FES_STATUS_LED_LEVEL
            int "WS2812 brightness (1-255; dim keeps the current low)"
            range 1 255
            default 16
            depends on FES_STATUS_LED_WS2812
    endmenu

    config FES_CONSOLE
        bool "USB console for testing (net, wifi, ping, ssh, exec ...)"
        default y

endmenu
```
